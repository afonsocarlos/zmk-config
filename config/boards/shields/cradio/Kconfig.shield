## config/boards/shields/cradio/Kconfig.shield
```kconfig
# Copyright (c) 2020 The ZMK Contributors
# SPDX-License-Identifier: MIT

config SHIELD_CRADIO_DONGLE
	def_bool $(shields_list_contains,cradio_dongle)

config SHIELD_CRADIO_LEFT
    def_bool $(shields_list_contains,cradio_left)

config SHIELD_CRADIO_PERIPHERAL_LEFT
    def_bool $(shields_list_contains,cradio_peripheral_left)

config SHIELD_CRADIO_PERIPHERAL_RIGHT
    def_bool $(shields_list_contains,cradio_peripheral_right)
```
