#include <behaviors.dtsi>
#include <behaviors/num_word.dtsi> // Requires zmk-auto-layer module.
#include <behaviors/unicode.dtsi> // Requires zmk-unicode module.
#include <zmk-helpers/helper.h> // Requires zmk-helpers module.
#include <dt-bindings/zmk/keys.h>
#ifdef CONFIG_WIRELESS
  #include <dt-bindings/zmk/bt.h>
  #include <dt-bindings/zmk/outputs.h>
  #define _BT_SEL_KEYS_L_                                                      \
      &bt_sel_linux 0 &bt_sel_macos 1 &bt_sel_linux 2 &bt_sel_linux 3 &bt_sel_linux 4
  #define _BT_SEL_KEYS_R_                                                      \
      &bt_sel_linux 5 &bt_sel_linux 6 &bt_sel_linux 7 &bt_sel_linux 8 &bt BT_CLR
#else
  #define _BT_SEL_KEYS_ &trans &trans &trans &trans &trans
#endif

#define DEF 0
#define MEDIA 1
#define NAV 2
#define NUM 3
#define GAME 4
#define SYM 5
#define SYS 6

#define XXX &none
#define ___ &trans

/* Global defaults */

#define QUICK_TAP_MS 175

&sk {
  release-after-ms = <900>;
  quick-release;
};

&sl { // Allow sticky mods to chord across sticky layers.
  ignore-modifiers;
};

&lt {
  flavor = "balanced";
  tapping-term-ms = <200>;
};

&uc {
  minimum-length = <4>;
};

/* Homerow mods */

#define KEYS_L LT0 LT1 LT2 LT3 LT4 LM0 LM1 LM2 LM3 LM4 LB0 LB1 LB2 LB3 LB4
#define KEYS_R RT0 RT1 RT2 RT3 RT4 RM0 RM1 RM2 RM3 RM4 RB0 RB1 RB2 RB3 RB4
#ifndef LH2
  #define THUMBS LH1 LH0 RH0 RH1         // Thumbs on 34 keys.
#else
  #define THUMBS LH2 LH1 LH0 RH0 RH1 RH2 // Thumbs on 36+ keys.
#endif

#define MAKE_HRM(NAME, HOLD, TAP, TRIGGER_POS)                                 \
  ZMK_HOLD_TAP(NAME, bindings = <HOLD>, <TAP>; flavor = "balanced";            \
               tapping-term-ms = <280>; quick-tap-ms = <QUICK_TAP_MS>;         \
               require-prior-idle-ms = <50>; hold-trigger-on-release;          \
               hold-trigger-key-positions = <TRIGGER_POS>;)

MAKE_HRM(hml, &kp, &kp, KEYS_R THUMBS) // Left-hand HRMs.
MAKE_HRM(hmr, &kp, &kp, KEYS_L THUMBS) // Right-hand HRMs.

// Hack: Make HRM combos tap-only (cf, ZMK issue #544).
#define ZMK_COMBO_8(NAME, TAP, POS, LAYERS, COMBO_MS, IDLE_MS, HOLD, SIDE)     \
  MAKE_HRM(hm_combo_##NAME, &kp, TAP, SIDE THUMBS)                             \
  ZMK_COMBO_6(NAME, &hm_combo_##NAME HOLD 0, POS, LAYERS, COMBO_MS, IDLE_MS)

/* Combos, leader key sequences, mouse emulation */

#include "combos.dtsi" // Must be sourced after HRM-combo hack.
#include "leader.dtsi"
#include "mouse.dtsi"

/* Nav cluster */

// Trigger tap-action on all interrupts.
#define MT_CORE                                                                \
  flavor = "tap-preferred";                                                    \
  tapping-term-ms = <220>;                                                     \
  quick-tap-ms = <220>;                                                        \
  hold-trigger-key-positions = <0>;

&mt { MT_CORE };

ZMK_HOLD_TAP(mt_home, bindings = <&masked_home>, <&kp>; MT_CORE)
ZMK_HOLD_TAP(mt_end, bindings = <&masked_end>, <&kp>; MT_CORE)

#define NAV_LEFT  &mt_home 0   LEFT  // Tap: left  | Long-tap: start of line.
#define NAV_RIGHT &mt_end 0    RIGHT // Tap: right | Long-tap: end   of line.
#define NAV_UP    &mt LC(HOME) UP    // Tap: up    | Long-tap: start of doc.
#define NAV_DOWN  &mt LC(END)  DOWN  // Tap: down  | Long-tap: end   of doc.
#define NAV_BSPC  &mt LC(BSPC) BSPC  // Tap: bspc  | Long-tap: delete word bwd.
#define NAV_DEL   &mt LC(DEL)  DEL   // Tap: del   | Long-tap: delete word fwd.
#define GAME_ESC  &mt LCTRL    ESC   // Tap: esc   | Long-tap: ctrl.

// Mask CTRL on left/right hold to avoid accidental jumps to start/end of doc.
#define MASK_MODS(NAME, MODS, BINDING)                                         \
  ZMK_MOD_MORPH(NAME, bindings = <BINDING>, <BINDING>; mods = <MODS>;)

MASK_MODS(masked_home, (MOD_LCTL), &kp HOME)
MASK_MODS(masked_end,  (MOD_LCTL), &kp END)

/* Magic-shift & auto-layers */

// Tap: sticky-shift |
// Shift + tap: caps-word |
// Double-tap: caps-line |
// Hold: shift.
#define MAGIC_SHIFT &magic_shift LSHFT 0
ZMK_HOLD_TAP(magic_shift, bindings = <&kp>, <&magic_shift_tap>;
             flavor = "balanced"; tapping-term-ms = <200>;
             quick-tap-ms = <QUICK_TAP_MS>;)
ZMK_MOD_MORPH(magic_shift_tap, bindings = <&sk LSHFT>, <&caps_word>;
              mods = <(MOD_LSFT)>;)
&caps_word { // Mods deactivate caps-word, requires PR #1451. [TODO: rebase]
  /delete-property/ ignore-modifiers;
};

// Tap: num-word | double-tap: sticky num-layer | Hold: num-layer.
#define SMART_NUM &smart_num NUM 0
ZMK_HOLD_TAP(smart_num, bindings = <&mo>, <&num_dance>; flavor = "balanced";
             tapping-term-ms = <200>; quick-tap-ms = <QUICK_TAP_MS>;)
ZMK_TAP_DANCE(num_dance, bindings = <&sl NUM>, <&num_word NUM>;
              tapping-term-ms = <200>;)

// Smart-mouse, requires tri-state module.
ZMK_TRI_STATE(
    smart_mouse, bindings = <&tog MEDIA>, <&none>, <&tog MEDIA>;
    ignored-key-positions =
        <LT1 LT2 LT3 LT4 LM1 LM2 LM3 LM4 LB0 LB1 LB2 LB3 LB4 RB1 RB2>;
    ignored-layers = <MEDIA SYM NUM>;)

/* Custom behaviors */

// Alt+Tab application window swapper, requires tri-state module.
ZMK_TRI_STATE(win_swapper, bindings = <&kt LALT>, <&kp TAB>, <&kt LALT>;
              ignored-key-positions = <LM1 LM2 LM3 RH0 RM0 RM1 RM2 RM3>;
              ignored-layers = <MEDIA NAV SYS>;)

// Define mod-morph with a *single* mod trigger for less repetition.
#define SIMPLE_MORPH(NAME, MOD, BINDING1, BINDING2)                            \
  ZMK_MOD_MORPH(NAME, mods = <(MOD_L##MOD | MOD_R##MOD)>;                      \
                bindings = <BINDING1>, <BINDING2>;)

// Tap: comma | Shift + tap: question-mark
SIMPLE_MORPH(comma_morph, SFT, &kp COMMA, &kp QMARK)

// Tap: dot | Shift + tap: exclamation-mark
SIMPLE_MORPH(dot_morph, SFT, &kp DOT, &kp EXCL)

// Tap: left/right parenthesis | Shft + tap: less-than/greater-than.
SIMPLE_MORPH(lpar_lt, SFT, &kp LPAR, &kp LT)
SIMPLE_MORPH(rpar_gt, SFT, &kp RPAR, &kp GT)

// Tap: space | Shift + tap: dot -> space -> sticky shift | Hold: nav layer.
#define MEDIA_SPC &lt MEDIA SPACE

// Tap: backspace | Lshft + tap: delete | Rshft + tap: shift-delete.
ZMK_MOD_MORPH(bs_del, bindings = <&kp BSPC>, <&kp DEL>;
              mods = <(MOD_LSFT|MOD_RSFT)>; keep-mods = <MOD_RSFT>;)

// Sticky shift + leader.
ZMK_MACRO(leader_sft, bindings = <&sk LSHFT &leader>;)
ZMK_MACRO(lrpar_lgt, bindings = <&lpar_lt &rpar_gt>;)
ZMK_MACRO(lrbkt, bindings = <&kp LBKT &kp RBKT>;)

/* Sym cluster */

ZMK_MACRO(less_eq,    bindings = <&kp LT &kp EQUAL>;)    // <=
ZMK_MACRO(double_eq,  bindings = <&kp EQUAL &kp EQUAL>;)  // ==
ZMK_MACRO(triple_eq,  bindings = <&kp EQUAL &kp EQUAL &kp EQUAL>;)  // ===
ZMK_MACRO(triple_neq, bindings = <&kp EXCL &kp EQUAL &kp EQUAL>;)    // !==
ZMK_MACRO(not_eq,     bindings = <&kp EXCL &kp EQUAL>;)     // !=
ZMK_MACRO(greater_eq, bindings = <&kp GT &kp EQUAL>;) // >=
ZMK_MACRO(null_safe,  bindings = <&kp QMARK &kp MINUS &kp GT>;)  // ?->
ZMK_MACRO(thin_arrow, bindings = <&kp MINUS &kp GT>;) // ->
ZMK_MACRO(fat_arrow,  bindings = <&kp EQUAL &kp GT>;)  // =>
ZMK_MACRO(double_col, bindings = <&kp COLON &kp COLON>;) // ::
ZMK_MACRO(sql_ego,    bindings = <&kp BSLH &kp LS(G)>;)    // \G

// Unicode OS swap
#define U_S_MACOS &uc UC_SET_MACOS
#define U_S_LINUX &uc UC_SET_LINUX

// Automatic OS Layer Swap for specific Bluetooth Profile
ZMK_MACRO_ONE_PARAM(bt_sel_linux, bindings = <&macro_param_1to2>, <&bt BT_SEL MACRO_PLACEHOLDER>, <U_S_LINUX>;)
ZMK_MACRO_ONE_PARAM(bt_sel_macos, bindings = <&macro_param_1to2>, <&bt BT_SEL MACRO_PLACEHOLDER>, <U_S_MACOS>;)

/* Keymap */

ZMK_CONDITIONAL_LAYER(sys, MEDIA NAV, SYS) // MEDIA + NAV --> SYS.

#ifndef ZMK_BASE_LAYER
  #define ZMK_BASE_LAYER(name, LT, RT, LM, RM, LB, RB, LH, RH)                 \
      ZMK_LAYER(name, LT RT LM RM LB RB LH RH)
#endif

ZMK_BASE_LAYER(Base,
//╭─────────────┬─────────────┬─────────────┬─────────────┬─────────────╮ ╭─────────────┬─────────────┬─────────────┬─────────────┬─────────────╮
    &kp Q         &kp W         &kp F         &kp P         &kp B       ,   &kp J         &kp L         &kp U         &kp Y         &kp SQT     ,
//├─────────────┼─────────────┼─────────────┼─────────────┼─────────────┤ ├─────────────┼─────────────┼─────────────┼─────────────┼─────────────┤
    &hml LGUI A   &hml LALT R   &hml LCTRL S  &hml LSHFT T  &kp G       ,   &kp M         &hmr RSHFT N  &hmr RCTRL E  &hmr LALT I   &hmr RGUI O ,
//├─────────────┼─────────────┼─────────────┼─────────────┼─────────────┤ ├─────────────┼─────────────┼─────────────┼─────────────┼─────────────┤
    &lt SYM Z     &kp X         &kp C         &kp D         &kp V       ,   &kp K         &kp H         &comma_morph  &dot_morph    &kp SEMI    ,
//╰─────────────┼─────────────┴─────────────┼─────────────┼─────────────┤ ├─────────────┼─────────────┼─────────────┴───────────────────────────╯
                                              SMART_NUM     MEDIA_SPC   ,   &lt NAV RET   MAGIC_SHIFT
//                                          ╰─────────────┴─────────────╯ ╰─────────────┴─────────────╯
)

ZMK_BASE_LAYER(Media,
//╭─────────────┬─────────────┬─────────────┬─────────────┬─────────────╮ ╭─────────────┬─────────────┬─────────────┬─────────────┬─────────────╮
    U_WH_U        &mkp RCLK     U_MS_U        &mkp LCLK     ___         ,   &kp C_MUTE    &kp C_RW      ___           &kp C_FF      &kp PSCRN   ,
//├─────────────┼─────────────┼─────────────┼─────────────┼─────────────┤ ├─────────────┼─────────────┼─────────────┼─────────────┼─────────────┤
    U_WH_D        U_MS_L        U_MS_D        U_MS_R        ___         ,   &kp C_VOL_UP  &kp C_PREV    &kp C_PP      &kp C_NEXT    &kp C_BRI_UP,
//├─────────────┼─────────────┼─────────────┼─────────────┼─────────────┤ ├─────────────┼─────────────┼─────────────┼─────────────┼─────────────┤
    U_WH_L        &mkp MB4      &mkp MCLK     &mkp MB5      U_WH_R      ,   &kp C_VOL_DN  &mo SYM       &mo NUM       ___           &kp C_BRI_DN,
//╰─────────────┼─────────────┴─────────────┼─────────────┼─────────────┤ ├─────────────┼─────────────┼─────────────┴───────────────────────────╯
                                              ___           ___         ,   ___           ___
//                                          ╰─────────────┴─────────────╯ ╰─────────────┴─────────────╯
)

ZMK_BASE_LAYER(Nav,
//╭─────────────┬─────────────┬─────────────┬─────────────┬─────────────╮ ╭─────────────┬─────────────┬─────────────┬─────────────┬─────────────╮
    &kp F12       &kp F7        &kp F8        &kp F9        ___         ,   &kp HOME      &kp PG_DN     &kp PG_UP     &kp END       NAV_BSPC    ,
//├─────────────┼─────────────┼─────────────┼─────────────┼─────────────┤ ├─────────────┼─────────────┼─────────────┼─────────────┼─────────────┤
    &hml LGUI F11 &hml LALT F4  &hml LCTRL F5 &hml LSHFT F6 ___         ,   NAV_LEFT      NAV_DOWN      NAV_UP        NAV_RIGHT     &kp RET     ,
//├─────────────┼─────────────┼─────────────┼─────────────┼─────────────┤ ├─────────────┼─────────────┼─────────────┼─────────────┼─────────────┤
    &kp F10       &kp F1        &kp F2        &kp F3        ___         ,   &kp INS       &kp TAB       ___           ___           &kp CAPS    ,
//╰─────────────┼─────────────┴─────────────┼─────────────┼─────────────┤ ├─────────────┼─────────────┼─────────────┴───────────────────────────╯
                                              ___           ___         ,   ___           ___
//                                          ╰─────────────┴─────────────╯ ╰─────────────┴─────────────╯
)

ZMK_BASE_LAYER(Num,
//╭─────────────┬─────────────┬─────────────┬─────────────┬─────────────╮ ╭─────────────┬─────────────┬─────────────┬─────────────┬─────────────╮
    ___           &kp N7        &kp N8        &kp N9        ___         ,   ___           &kp N7        &kp N8        &kp N9        ___         ,
//├─────────────┼─────────────┼─────────────┼─────────────┼─────────────┤ ├─────────────┼─────────────┼─────────────┼─────────────┼─────────────┤
    &hml LGUI N0  &hml LALT N4  &hml LCTRL N5 &hml LSHFT N6 ___         ,   ___           &hmr LSHFT N4 &hmr LCTRL N5 &hmr LALT N6 &hmr LGUI N0,
//├─────────────┼─────────────┼─────────────┼─────────────┼─────────────┤ ├─────────────┼─────────────┼─────────────┼─────────────┼─────────────┤
    &kp DOT       &kp N1        &kp N2        &kp N3        ___         ,   ___           &kp N1        &kp N2        &kp N3        &kp DOT     ,
//╰─────────────┼─────────────┴─────────────┼─────────────┼─────────────┤ ├─────────────┼─────────────┼─────────────┴───────────────────────────╯
                                              ___           ___         ,   ___           ___
//                                          ╰─────────────┴─────────────╯ ╰─────────────┴─────────────╯
)

ZMK_BASE_LAYER(Game,
//╭─────────────┬─────────────┬─────────────┬─────────────┬─────────────╮ ╭─────────────┬─────────────┬─────────────┬─────────────┬─────────────╮
    &kp TAB       &kp Q         &kp W         &kp E         &kp R       ,   ___           &mkp LCLK     U_MS_U        &mkp RCLK     U_WH_U      ,
//├─────────────┼─────────────┼─────────────┼─────────────┼─────────────┤ ├─────────────┼─────────────┼─────────────┼─────────────┼─────────────┤
    GAME_ESC      &kp A         &kp S         &kp D         &kp F       ,   ___           U_MS_L        U_MS_D        U_MS_R        U_WH_D      ,
//├─────────────┼─────────────┼─────────────┼─────────────┼─────────────┤ ├─────────────┼─────────────┼─────────────┼─────────────┼─────────────┤
    &kp LSHFT     &kp N1        &kp N2        &kp N3        &kp N4      ,   U_WH_L        &mkp MB4      &mkp MCLK     &mkp MB5      U_WH_R      ,
//╰─────────────┼─────────────┴─────────────┼─────────────┼─────────────┤ ├─────────────┼─────────────┼─────────────┴───────────────────────────╯
                                              ___           &kp SPACE   ,   &kp RET       ___
//                                          ╰─────────────┴─────────────╯ ╰─────────────┴─────────────╯
)

ZMK_BASE_LAYER(Sym,
//╭─────────────┬─────────────┬─────────────┬─────────────┬─────────────╮ ╭─────────────┬─────────────┬─────────────┬─────────────┬─────────────╮
    ___           ___           ___           ___           ___         ,   ___           &kp N7        &kp N8        &kp N9        ___         ,
//├─────────────┼─────────────┼─────────────┼─────────────┼─────────────┤ ├─────────────┼─────────────┼─────────────┼─────────────┼─────────────┤
    ___           ___           ___           ___           &sql_ego    ,   &less_eq      &double_eq    &triple_eq    &not_eq       &greater_eq ,
//├─────────────┼─────────────┼─────────────┼─────────────┼─────────────┤ ├─────────────┼─────────────┼─────────────┼─────────────┼─────────────┤
    ___           ___           ___           ___           ___         ,   &null_safe    &thin_arrow   &triple_neq   &fat_arrow    &double_col ,
//╰─────────────┼─────────────┴─────────────┼─────────────┼─────────────┤ ├─────────────┼─────────────┼─────────────┴───────────────────────────╯
                                              ___           ___         ,   ___           ___
//                                          ╰─────────────┴─────────────╯ ╰─────────────┴─────────────╯
)

ZMK_BASE_LAYER(Sys,
//╭─────────────┬─────────────┬─────────────┬─────────────┬─────────────╮ ╭─────────────┬─────────────┬─────────────┬─────────────┬─────────────╮
                               _BT_SEL_KEYS_L_                          ,                               _BT_SEL_KEYS_R_                         ,
//├─────────────┼─────────────┼─────────────┼─────────────┼─────────────┤ ├─────────────┼─────────────┼─────────────┼─────────────┼─────────────┤
    &bootloader   ___           &out OUT_USB  &out OUT_BLE  ___         ,   ___           ___           ___           ___           &bootloader  ,
//├─────────────┼─────────────┼─────────────┼─────────────┼─────────────┤ ├─────────────┼─────────────┼─────────────┼─────────────┼─────────────┤
    &sys_reset    ___           U_S_MACOS     U_S_LINUX     ___         ,   ___           ___           ___           ___           &sys_reset   ,
//╰─────────────┼─────────────┴─────────────┼─────────────┼─────────────┤ ├─────────────┼─────────────┼─────────────┴───────────────────────────╯
                                              ___           ___         ,   ___           ___
//                                          ╰─────────────┴─────────────╯ ╰─────────────┴─────────────╯
)

/* vim: set ft=c tw=146: */
